## package/tinymembench/Config.in
```kconfig
config BR2_PACKAGE_TINYMEMBENCH
	bool "tinymembench"
	depends on !BR2_MIPS_NABI32 && !BR2_MIPS_NABI64
	help
	  Tinymembench is a simple memory benchmark program, which
	  tries to measure the peak bandwidth of sequential memory
	  accesses and the latency of random memory accesses.
	  Bandwidth is measured by running different assembly code for
	  the aligned memory blocks and attempting different prefetch
	  strategies.

	  https://github.com/ssvb/tinymembench

config BR2_TINYMEMBENCH_MINREPEATS
	int "Minimum number of repeats"
	default "3"
	depends on BR2_PACKAGE_TINYMEMBENCH
	help
	  Minimum number of repeats per test

config BR2_TINYMEMBENCH_MAXREPEATS
	int "Maximum number of repeats"
	default "20"
	depends on BR2_PACKAGE_TINYMEMBENCH
	help
	  Minimum number of repeats per test

config BR2_TINYMEMBENCH_LATBENCH_COUNT
	int "Number of rounds in latency bench"
	default "10000000"
	depends on BR2_PACKAGE_TINYMEMBENCH
	help
	  Number of rounds in latency bench per block size
```
